## Broadcom_OpenBFC_rg/rg/linux-3.14/Documentation/devicetree/bindings/i2c/i2c-brcmwbid.txt
```
Broadcom WBID (Wireless Board Identifier) i2c device client

Required properties:

- compatible: should be "brcm,wbid"
- reg: specifies the I2C address and second address is the spinlock address

Example:


i2c@14e00e00 {
	clock-frequency = <50000>;
	compatible = "brcm,brcmper-i2c";
	reg = <0x14e00e00 0x58>,
	      <0x104b00f4 0x4>;
	port-select = <1>;
	#address-cells = <1>;
	#size-cells = <0>;

	wbid@24 {
		compatible = "brcm,wbid";
		reg = <0x24>;
	};
};
```

## Broadcom_OpenBFC_rg/rg/linux-3.14/Documentation/devicetree/bindings/interrupt-controller/brcm,bcm7120-l2-intc.txt
```
Broadcom BCM7120 Level 2 interrupt controller

- typically has one 32-bit enable word and one 32-bit status word, but on
  some hardware may have more than one enable/status pair

- no atomic set/clear operations

- not all bits within the interrupt controller actually map to an interrupt
Required properties:

- compatible: should be "brcm,bcm7120-l2-intc"
- reg: specifies the base physical address and size of the registers;
  multiple pairs may be specified, with the first pair handling IRQ offsets
  0..31 and the second pair handling 32..63
- interrupt-controller: identifies the node as an interrupt controller
- #interrupt-cells: specifies the number of cells needed to encode an interrupt
  source, should be 1.
- interrupt-parent: specifies the phandle to the parent interrupt controller
  this one is cascaded from
- interrupts: specifies the interrupt line(s) in the interrupt-parent domain
  to be used for cascading
- brcm,int-map-mask: 32-bits bit mask describing how the interrupts at this level
  map to their respective parents. Should match exactly the number of interrupts
  specified in the 'interrupts' property, multiplied by the number of
  enable/status register pairs implemented by this controller.  For
  multiple parent IRQs with multiple enable/status words, this looks like:
  <irq0_w0 irq0_w1 irq1_w0 irq1_w1 ...>

Optional properties:

- brcm,irq-can-wake: if present, this means the L2 controller can be used as a
  wakeup source for system suspend/resume.

- brcm,int-fwd-mask: if present, a bit mask to configure the interrupts which
  have a mux gate, typically UARTs. Setting these bits will make their
  respective interrupt outputs bypass this 2nd level interrupt controller
  completely; it is completely transparent for the interrupt controller
  parent. This should have one 32-bit word per enable/status pair.

Example:

irq0_intc: interrupt-controller@f0406800 {
	compatible = "brcm,bcm7120-l2-intc";
	interrupt-parent = <&intc>;
	#interrupt-cells = <1>;
	reg = <0xf0406800 0x8>;
	interrupt-controller;
	interrupts = <0x0 0x42 0x0>, <0x0 0x40 0x0>;
	interrupt-names = "upg_main", "upg_bsc";
	brcm,int-map-mask = <0xeb8>, <0x140>;
	brcm,int-fwd-mask = <0x7>;
};
```

## Broadcom_OpenBFC_rg/rg/linux-3.14/Documentation/devicetree/bindings/pci/brcmstb-pci.txt
```
Brcmstb PCIe Host Controller Device Tree Bindings

Introduction:

The brcmstb host controller closely follows the example set in

	[1] http://devicetree.org/Device_Tree_Usage#PCI_Host_Bridge

The rest of this document explains some added customizations and
offers an example Brcmstb PCIe host controller DT node.

Required Properties:
  reg -- the register start address and length for the PCIe block.
      Additional start,length pairs may be specified for clock addresses.
  interrupts -- this must be specified but it is used indirectly.  Interrupt
      zero must be specified; the Brcmstb driver code uses this interrupt
      to determine the offset used for all interrupts, specifically, those
      listed in interrupt-map.
  compatible -- must specify the string "brcm,pci-plat-dev".
  #address-cells -- the number of address cells for PCI-space.
  #size-cells -- the number of size cells for PCI-space.
  ranges -- See [1]; a specification of the outbound windows for the host
      controller.  Each outbound window is described by a 7-tuple:
          (3 entries) -- PCIe space start address (0th entry is ignored).
          (2 entries) -- CPU/System start address
          (2 entries) -- Size of region.
      Due to hardware limitations, there may be a maximum of four windows
      specified.
  #interrupt-cells -- number of cells used to describe the interrupt.
  interrupt-map -- See [1]; each interrupt requires 7 entries, and
      currently all but the fifth entry (order 0) -- the interrupt
      number -- is ignored.  There must be four interrupts specified
      for the PCI's INTA, INTB, INTC, and INTD.

Optional Properties:
  interrupt-names -- names of the interrupts listed in the interrupt map.
  clocks -- list of clock phandles.  If specified, this should list one
      clock.
  clock-names -- the "local" names of the clocks specified in 'clocks'.  Note
      that if the 'clocks' property is given, 'clock-names' is mandatory,
      and the name of the clock is expected to be "sw_pcie".
  brcm,ssc -- (boolean) indicates usage of spread-spectrum clocking.
  brcm,gen --  (integer) indicates desired generation of link:
      1 => 2.5 Gbps, 2 => 5.0 Gbps, 3 => 8.0 Gbps.
  supply-names -- the names of voltage regulators that the root
      complex should turn off/on/on on suspend/resume/boot.  This
      is a string list.
  supplies -- A collection of phandles to a regulator nodes, see
	Documentation/devicetree/bindings/regulator/ for specific
	bindings. The number and order of phandles must match
	exactly the number of strings in the "supply-names" property.

Example Node:

	pcie0: pcie@f1080000 {
		ranges = <0x2000000 0x0 0xc0000000 0x0 0xc0000000 0x0 0x8000000>;
		brcm,log2-scb-sizes = <0x1e>;
		reg = <0x0 0xf1080000 0x0 0x9310>;
		interrupts = <0x0 0x0 0x4>;
		compatible = "brcm,pci-plat-dev";
		#address-cells = <0x3>;
		#size-cells = <0x2>;
		tot-num-pcie = <0x3>;
		#interrupt-cells = <0x1>;
		interrupt-map-mask = <0xf800 0x0 0x0 0x7>;
		interrupt-map = <0x0 0x0 0x0 0x1 0x1 0x2b 0x3 0x0 0x0 0x0 0x2 0x1 0x2c 0x3 0x0 0x0 0x0 0x3 0x1 0x2d 0x3 0x0 0x0 0x0 0x4 0x1 0x2e 0x3>;
		interrupt-names = "pcie0_inta", "pcie0_intb", "pcie0_intc", "pcie0_intd";
		brcm,ssc;
		clocks = <&sw_pcie0>;
		clock-names = "sw_pcie";
		supply-names = "vreg-wl0";
		vreg-wl0-supply = <&vreg_wl0>;
	};

	pcie1: pcie@f1090000 {
		ranges = <0x2000000 0x0 0xc8000000 0x0 0xc8000000 0x0 0x4000000>;
		brcm,log2-scb-sizes = <0x1e>;
		reg = <0x0 0xf1090000 0x0 0x9310>;
		interrupts = <0x0 0x0 0x4>;
		compatible = "brcm,pci-plat-dev";
		#address-cells = <0x3>;
		#size-cells = <0x2>;
		tot-num-pcie = <0x3>;
		#interrupt-cells = <0x1>;
		interrupt-map-mask = <0xf800 0x0 0x0 0x7>;
		interrupt-map = <0x0 0x0 0x0 0x1 0x1 0x32 0x3 0x0 0x0 0x0 0x2 0x1 0x33 0x3 0x0 0x0 0x0 0x3 0x1 0x34 0x3 0x0 0x0 0x0 0x4 0x1 0x35 0x3>;
		interrupt-names = "pcie1_inta", "pcie1_intb", "pcie1_intc", "pcie1_intd";
		brcm,ssc;
		clocks = <&sw_pcie0>;
		clock-names = "sw_pcie";
		supply-names = "vreg-wl1";
		vreg-wl1-supply = <&vreg_wl1>;
	};

	pcie2: pcie@f10c0000 {
		ranges = <0x2000000 0x0 0xcc000000 0x0 0xcc000000 0x0 0x4000000>;
		brcm,log2-scb-sizes = <0x1e>;
		reg = <0x0 0xf10c0000 0x0 0x9310>;
		interrupts = <0x0 0x0 0x4>;
		compatible = "brcm,pci-plat-dev";
		#address-cells = <0x3>;
		#size-cells = <0x2>;
		tot-num-pcie = <0x3>;
		#interrupt-cells = <0x1>;
		interrupt-map-mask = <0xf800 0x0 0x0 0x7>;
		interrupt-map = <0x0 0x0 0x0 0x1 0x1 0x59 0x3 0x0 0x0 0x0 0x2 0x1 0x5a 0x3 0x0 0x0 0x0 0x3 0x1 0x5b 0x3 0x0 0x0 0x0 0x4 0x1 0x5c 0x3>;
		interrupt-names = "pcie2_inta", "pcie2_intb", "pcie2_intc", "pcie2_intd";
		brcm,ssc;
		clocks = <&sw_pcie0>;
		clock-names = "sw_pcie";
		supply-names = "vreg-wl2";
		vreg-wl2-supply = <&vreg_wl2>;
	};
```

## Broadcom_OpenBFC_rg/rg/linux-3.14/Documentation/devicetree/bindings/pinctrl/brcm,bcm3384-pinctrl-gpio.txt
```
Broadcom BCM3384 GPIO (and pinmux) controller

The BCM3384 GPIO module is a combined GPIO controller, (GPIO) interrupt
controller, and pinmux/control device.

Required properties:

- compatible:
    Must be "brcm,bcm3384-pinctrl-gpio"

- reg:
    entry    description
    1        Physical address of the GPIO direction registers
    2        Physical address of the GPIO data registers
    3        Physical address of the GPIO mux registers
    4        Physical address of the GPIO mux readback register
    5        Physical address of the mailbox synchronization register used for
             a hardware spinlock between the router and cable modem CPU's
    6        Physical address of the GPIO IRQ control mux register
    7        Physical address of the GPIO IRQ mux low register
    7        Physical address of the GPIO IRQ mux high register
    8        Physical address of the G2U bridge IRQ status register

- #gpio-cells:
    Should be two. The first cell is the pin number and the
    second cell is used to specify optional parameters:
    - bit 0 specifies polarity (0 for active high, 1 for active low)

- gpio-controller:
    Marks the device node as a GPIO controller.

- #interrupt-cells:
    Should be 2.
    The first cell is the GPIO number.
    The second cell is used to specify flags:
        bits[3:0] trigger type and level flags:
            1 = low-to-high edge triggered.
            2 = high-to-low edge triggered.
            4 = active high level-sensitive.
            8 = active low level-sensitive.
            Valid combinations are 1, 2, 3, 4, 8.

- interrupt-parent:
    phandle referencing the parent interrupt controller

- interrupts:
    The interrupt output from the controller.

- interrupt-controller:
    Marks the device node as an interrupt controller.

- brcm,num-gpio-pins:
    The total number of GPIO pins. Each of these pins can also be configured for
    an alternate pinmux function.

- brcm,num-pinmux-funcs:
    The total number of pinmux functions that can be assigned to each GPIO pin.

- brcm,parent-irq-status-bit:
    The bit in the parent interrupt controller status register representing the
    IRQ for this GPIO interrupt controller.

- brcm,gpio_irq_slot_assignments:
    The underlying hardware only allow 6 of the total GPIO's to be configured
    to provide interrupts at any given time. The assignments are hereafter
    referred to as slots. This property indicates the slot numbers (0-based)
    that are reserved for use by Linux running on the router CPU. Those not
    listed are reserved for use by the rest of the system (the cable modem CPU).

Please refer to ../gpio/gpio.txt for a general description of GPIO bindings.

Optional properties:

Please refer to pinctrl-bindings.txt in this directory for details of the
common pinctrl bindings used by client devices, including the meaning of the
phrase "pin configuration node".

- pinctrl-names:
    Names of the various pinctrl states specified by the pinctrl-0, pinctrl-1, etc
    properties. The pinctrl-0 prioerty should be names "default" as this is the
    property that is instantiated during the pinctrl subsystem initialization
    during boot.

- pinctrl-xxx:
    pinctrl-0, pinctrl-1, etc. Each pinctrl-xxx specifies an array of pin
    configuration node phandles. The array of phandles specifies a pinctrl state
    that can be configured via the pinctrl subsystem API. pinctrl-0 is the default
    pinctrl state that is set during the pinctrl subsystem init at boot.

Pin configuration subnode properties:

Each pin configuration node lists the pin(s) to which it applies and one or
more of the mux function to select on those pin(s).

- brcm,pins: An array of cells. Each cell contains the ID of a pin. Valid IDs
  are the integer GPIO IDs; 0==GPIO0, 1==GPIO1, ... 53==GPIO53.

- brcm,function: Integer, containing the function to mux to the pin(s):
    0: function 0
    1: function 1
    2: function 2
    3: function 3
    4: function 4
    5: function 5 (GPIO)
    6: function 6
    7: function 7
    Each of the brcm,function properties may contain either a single value which
    will be applied to all pins in brcm,pins, or a value for each entry in
    brcm,pins.

Example:

        pinctrl_gpio: pinctrl_gpio@14e00100 {
                compatible = "brcm,bcm3384-pinctrl-gpio";
                reg = <0x14e00100 0x2c>,        /* GPIO direction regs          */
                      <0x14e0012c 0x2c>,        /* GPIO data regs               */
                      <0x14e0029c 0x14>,        /* GPIO mux regs                */
                      <0x14e00080 0x4>,         /* GPIO mux readback reg        */
                      <0x104b00f8 0x4>,         /* MBOX cfg reg (HW spinlock)   */
                      <0x14e0006c 0x4>,         /* GPIO IRQ ctrl reg            */
                      <0x14e00098 0x4>,         /* GPIO IRQ mux lo reg          */
                      <0x14e003f4 0x4>,         /* GPIO IRQ mux hi reg          */
                      <0x104b0064 0x4>;         /* G2U ZMIPS IRQ status reg     */
                #gpio-cells = <0x2>;
                gpio-controller;
                brcm,num-gpio-pins = <147>;
                brcm,num-pinmux-funcs = <8>;
                #interrupt-cells = <2>;
                interrupt-parent = <&zmips_intc>;
                interrupts = <14>;
                interrupt-controller;
                brcm,parent-irq-status-bit = <14>;
                brcm,gpio_irq_slot_assignments = <3 4 5>;

                pinctrl-names = "default";
                pinctrl-0 = <&wifi_pwr_ctrl
                             &ethsw_mdio &ethsw_rgmii &ethsw_spi &ethsw_pwr_ctrl
                             &wifi_wps>;
                wifi_pwr_ctrl: wifi_pwr_ctrl {
                        brcm,pins = <4 5>;
                        brcm,function = <5>; /* GPIO */
                };
                ethsw_mdio: ethsw_mdio {
                        brcm,pins = <38 39>;
                        brcm,function = <4>; /* MDIO */
                };
                ethsw_rgmii: ethsw_rgmii {
                        brcm,pins = <54 55 56 57 58 59 60 61 62 63 64 65>;
                        brcm,function = <1>; /* RGMII */
                };
                ethsw_spi: ethsw_spi {
                        brcm,pins = <84 85 86 89>;
                        brcm,function = <0 0 0 1>; /* SPI */
                };
                ethsw_pwr_ctrl: ethsw_pwr_ctrl {
                        brcm,pins = <14>;
                        brcm,function = <5>; /* GPIO */
                };
                wifi_wps: wifi_wps {
                        brcm,pins = <6 7 40>;
                        brcm,function = <5>; /* GPIO */
                };
        };
```

## Broadcom_OpenBFC_rg/rg/linux-3.14/Documentation/devicetree/bindings/spi/brcm,bcm6328-hsspi.txt
```
Broadcom BCM6328 High-Speed SPI controller

Required properties:

- compatible: Should be "brcm,bcm6328-hsspi"
- reg: Should contain the register base address and length
- interrupts: Should contain the interrupt number
- clocks: The clock feeding this SPI controller
- clock-names: Should be "hsspi"
- #address-cells: Must be 1 for child chip-select nodes
- #size-cells: Must be 0 for child chip-select nodes

Optional sub-nodes:

Example:

spi@b0001000 {
       compatible = "brcm,bcm6328-hsspi";
       reg = <0xb0001000 0x600>;
       interrupts = <29>;
       clocks = <&hsspi_clock>;
       clock-names = "hsspi";
       #address-cells = <1>;
       #size-cells = <0>;

       flash@0 {
               compatible = "m25p80";
               spi-max-frequency = <125000000>;
               reg = <0>;

               ...
       };
};
```
