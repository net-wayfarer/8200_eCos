
/include/ "rg.3390b0-batt-vcms.dts"
/include/ "rg.3390z0-bolt.dtsi"

/********************************************************************
 * any nodes that appear below are platform specific additions and
 * replacements.
 * The dtc will add or replace any properties in the nodes
 * below to the same nodes that appear in include files above.
 * If the property does not exist in the node above it will be added.
 * If the property does exist it will replace it.
 ********************************************************************/
/ {
	model = "Broadcom CM (3390z0)";
	compatible = "brcm,bcm3390z0", "brcm,brcmstb";

	identifier@0 {
			    /*			     BMU mbox0: */
			    /* chip id    mfg id     on battery */
		chipid_reg = < 0x20404000 0x204e6120 0x03800080 >;
		chipid_msk = < 0xffffffff 0x0000f000 0x00000008 >;
		chipid_val = < 0x33900060 0x0000a000 0x00000008 >;
			     /*
			      * Only boards supporting battery. Can't rely on
			      * BMU's mbox0 power state on non-battery boards.
			      */
			     /* VCMS */
		boardid_msk = < 0xff >;
		boardid_val = < 0x82 >;
	};

	/*
	 * Override the rg.3390b0-batt.dtsi identifier@1 so we only have
	 * a single identifier node to match.
	 */
	identifier@1 {
			    /* chip id    */
		chipid_reg = < 0x20404000 >;
		chipid_msk = < 0xffffffff >;
		chipid_val = < 0x00000000 >;
	};
};
